/*

	This file is part of Frogger2, (c) 1999 Interactive Studios Ltd.


	File		: layout.c
	Programmer	: Andrew Eder
	Date		: 01/03/99

----------------------------------------------------------------------------------------------- */

#define F3DEX_GBI_2

// *ASL* 12/08/2000 - Seconds the frog logo is active in the frontend
#define FROG_LOGO_ACTIVE_SECS	5


#include "prefix_dc.h"

#ifndef PSX_VERSION

#include <windows.h>
#include <ddraw.h>
#include <d3d.h>

#endif

#include <islmem.h>
#include <islutil.h>

#include "ultra64.h"
#include "layout.h"
#include "types.h"
#include "sprite.h"
#include "platform.h"
#include "collect.h"
#include "map.h"
#include "textover.h"
#include "enemies.h"
#include "babyfrog.h"
#include "event.h"
#include "tongue.h"
#include "game.h"
#include "cam.h"
#include "hud.h"
#include "frontend.h"
#include "script.h"
#include "Main.h"
#include "maths.h"
#include "newpsx.h"
#include "menus.h"
#include "specfx.h"
//ma#include "e3_demo.h"
#include "levplay.h"
#include "frogmove.h"
#include "fadeout.h"
#include "backdrop.h"
#include "story.h"
#include "particle.h"
#include "multi.h"
#include "training.h"
#include "ptexture.h"
#include "options.h"
#include "memcard.h"
//ma#include "flatpack.h"

#ifdef PSX_VERSION
//ma#include <libspu.h>
#include "Bff_Load.h"
#include "Objects.h"
#include "Map_Draw.h"
#include "Water.h"
#include "temp_psx.h"
#include "audio.h"
#include "backdrop.h"
#include "loadingbar.h"
#include "eff_draw.h"
//#include <islxa.h>
#else
#include <banks.h>
#include <mdx.h>
#include <pcsprite.h>
extern MDX_LANDSCAPE *world;
#include <pcaudio.h>
#include <pcmisc.h>
#endif

#include "lang.h"
#include "islvideo.h"

//stuff taken out of PSX main,
//for commonality
fixed gameSpeed = 4096;
char quitMainLoop;
unsigned long actFrameCount = 0;
unsigned long lastActFrameCount = 0;
ULONG	frame;
VECTOR bbsrc, bbtar;
char useAudio = 1;
char screenshotEnable = 0;
int gameTextLang = LANG_DEFAULT;

extern int restartingLevel;
extern unsigned long USE_MENUS;
extern long startCam;
extern TIMER endLevelTimer;

extern AC_ERROR_PTR		acErr;
extern AM_ERROR			*amErr;

unsigned long worldNum;
unsigned long levelNum;

unsigned char darkenedLevel		= 0;
short lightIntensity	= 255;

//void LSCAPE_DrawSortedPrimitives(int);
//void customDrawPrimitives2(int, long*);

//BB
//This really sucks.
//Gotta do a get-around 'cos psiDestroy doesn't work
//if psiAllocWorkspace hasn't been called.
int AllowPsiDestroy = 0;

// *ASL* 12/08/2000 - Frog logo timer
extern TIMER frogLogoTimer;


#ifdef PSX_VERSION
WORLD_VISUAL_DATA origWorldVisualData[MAX_WORLDS] = 
{
//------------------------------------------------ GARDEN
	{
	STR_WORLD_GARDEN,				// description
	WORLDID_GARDEN,			// world ID
	GARDENMASTER_OBJ_BANK,		// master object bank
	GARDEN_TEX_BANK,		// master texture bank
	WORLD_OPEN,
	1,						// number of levels
	1,						// number of single player levels
		{ 
		STR_LEVEL_GARDEN1,	"LEV_GAR1",0,		LEVELID_GARDEN1,LEVELID_ANCIENT1,WORLDID_ANCIENT,GARDENLEV1_OBJ_BANK,0,GARDENLEV1_COL,LEVEL_OPEN,0,WORLDID_ANCIENT,0,  0,0,0,650,780,400,"LOZ",7000,GARDEN1_STAK,350,0,
//		STR_LEVEL_GARDENMULTI,"GARDEN1",0,	LEVELID_GARDEN6,LEVELID_ANCIENT1,WORLDID_ANCIENT,GARDENMULTI_OBJ_BANK,0,GARDENMULTI_COL,LEVEL_OPEN,0,-1,0, 0,0, 0,1100,1100,60,"SIMON",7000,
		},
	},

//------------------------------------------------ ANCIENT

	{
	STR_WORLD_ANCIENT,			// description
	WORLDID_ANCIENT,		// world ID
	ANCIENTMASTER_OBJ_BANK,	// master object bank
	ANCIENT_TEX_BANK,	// master texture bank
	WORLD_CLOSED,
	4,						// number of levels
	3,						// number of single player levels
		{ 
//		STR_LEVEL_ANCIENT1,"ANCIENT1",0,		LEVELID_ANCIENT1,LEVELID_SUBTERRANEAN1,WORLDID_SUBTERRANEAN,ANCIENTLEV1_OBJ_BANK,0,ANCIENTLEV1_COL,LEVEL_OPEN,0,-1,0, 0,0, 0,800,1000,80,"SANDRO",7000,
		STR_LEVEL_ANCIENT1,"LEV_ANC1",0,		LEVELID_ANCIENT1,LEVELID_SUBTERRANEAN1,WORLDID_SUBTERRANEAN,ANCIENTLEV1_OBJ_BANK,0,ANCIENTLEV1_COL,LEVEL_CLOSED,0,-1,0, 0,0, 0,800,1000,800,"SAN",7000,ANCIENTS1_STAK,690,0,
		STR_LEVEL_ANCIENT2,"LEV_ANC2",0,		LEVELID_ANCIENT3,LEVELID_SUBTERRANEAN2,WORLDID_SUBTERRANEAN,ANCIENTLEV3_OBJ_BANK,0,ANCIENTLEV3_COL,LEVEL_CLOSED,0,-1,0, 0,0, 0,800,1100,1400,"MAT",7000,ANCIENTS2_STAK,1200,0,
		STR_LEVEL_ANCIENT3,"LEV_ANC3",0,		LEVELID_ANCIENT4,LEVELID_ANCIENT3,WORLDID_ANCIENT,ANCIENTBOSS_OBJ_BANK,0,ANCIENTMASTER_COL,LEVEL_CLOSED,0,-1,0, 0,0, 0,1100,1100,850,"JIM",7000,ANCIENTS3_STAK,720,0,
		STR_LEVEL_ANCIENTMULTI,"GARDEN1",0,	LEVELID_ANCIENT6,LEVELID_ANCIENT1,WORLDID_ANCIENT,ANCIENTMULTI_OBJ_BANK,0,ANCIENTMULTI_COL,LEVEL_OPEN,1,-1,0, 0,0, 0,1100,1100,600,"DAV",9000,ANCIENTSMULTI_STAK,3300,0,
		},
	},


//------------------------------------------------ SPACE

	{
	STR_WORLD_SPACE,			// description
	WORLDID_SPACE,		// world ID
	SPACEMASTER_OBJ_BANK,		// master object bank
	SPACE_TEX_BANK,		// master texture bank
	WORLD_CLOSED,
	3,						// number of levels
	3,						// number of single player levels
		{ 
		STR_LEVEL_SPACE1,"LEV_SPA1",0,		LEVELID_SPACE1,LEVELID_LABORATORY3,WORLDID_LABORATORY,SPACELEV1_OBJ_BANK,0,SPACELEV1_COL,LEVEL_CLOSED,0,-1,0, 0,0, 0,500,1100,1700,"BYR",7000,SPACE1_STAK,1600,0,
		STR_LEVEL_SPACE2,"LEV_SPA2",0,		LEVELID_SPACE3,LEVELID_SPACE1,WORLDID_SPACE,SPACELEV3_OBJ_BANK,0,SPACELEV3_COL,LEVEL_CLOSED,0,-1,0, 0,0, 0,1100,1800,950,"RAN",14000,SPACE2_STAK,830,0,
		STR_LEVEL_SPACE3,"LEV_SPA3",0,		LEVELID_SPACE4,LEVELID_HALLOWEEN1,WORLDID_HALLOWEEN,SPACEBOSS_OBJ_BANK,0,SPACEMASTER_COL,LEVEL_CLOSED,0,-1,0, 0,0, 0,1100,1100,2200,"JOF",7000,SPACE3_STAK,2000,0,
//		STR_LEVEL_SPACEMULTI,"SPACE1",0,	LEVELID_SPACE6,LEVELID_LABORATORY1,WORLDID_LABORATORY,SPACEMULTI_OBJ_BANK,0,SPACEMULTI_COL,LEVEL_OPEN,0,-1,0, 0,0, 0,1100,1100,60,"RICHARD",7000,
		},
	},

//------------------------------------------------ CITY

	{
	STR_WORLD_CITY,				// description
	WORLDID_CITY,		// world ID
	CITYMASTER_OBJ_BANK,		// master object bank
	CITY_TEX_BANK,		// master texture bank
	WORLD_OPEN,
	1,						// number of levels
	0,						// number of single player levels
		{ 
//		STR_LEVEL_CITY1,"CITY1",80,			LEVELID_CITY1,LEVELID_CITY2,WORLDID_CITY,CITYLEV1_OBJ_BANK,0,CITYLEV1_COL,LEVEL_OPEN,0,-1,0, 0,0, 0,1100,1100,150,"BRUCE",7000,
//		STR_LEVEL_CITY2,"CITY2",80,			LEVELID_CITY2,LEVELID_CITY3,WORLDID_CITY,CITYLEV2_OBJ_BANK,0,CITYLEV2_COL,LEVEL_OPEN,0,-1,0, 0,0, 0,1100,1100,160,"MIKE",7000,
//		STR_LEVEL_CITY3,"CITY3",90,			LEVELID_CITY3,LEVELID_SUBTERRANEAN1,WORLDID_SUBTERRANEAN,CITYLEV3_OBJ_BANK,0,CITYLEV3_COL,LEVEL_OPEN,0,-1,0, 100,100, 000,350,1100,150,"ANDY",7000,
		STR_LEVEL_CITYMULTI,"GARDEN1",0,	LEVELID_CITY6,LEVELID_CITY6,WORLDID_CITY,CITYMULTI_OBJ_BANK,0,CITYMULTI_COL,LEVEL_OPEN,1,-1,0, 0,0, 0,1100,1100,600,"ALX",7000,CITYMULTI_STAK,3000,0,
		},
	},

//------------------------------------------------ SUBTERRANEAN

	{
	STR_WORLD_SUB,				// description
	WORLDID_SUBTERRANEAN,		// world ID
	SUBTERRANEANMASTER_OBJ_BANK,		// master object bank
	SUBTERRANEAN_TEX_BANK,		// master texture bank
	WORLD_CLOSED,
	3,						// number of levels
	3,						// number of single player levels
		{ 
		STR_LEVEL_SUB1,"LEV_SUB1",0,				LEVELID_SUBTERRANEAN1,LEVELID_ANCIENT3,WORLDID_ANCIENT,SUBTERRANEANLEV1_OBJ_BANK,0,SUBTERRANEANLEV1_COL,LEVEL_CLOSED,0,-1,0, 0,0, 0,1100,1100,1150,"KEV",7000,SUB1_STAK,1020,0,
		STR_LEVEL_SUB2,"LEV_SUB2",0,				LEVELID_SUBTERRANEAN2,LEVELID_SUBTERRANEAN3,WORLDID_SUBTERRANEAN,SUBTERRANEANLEV2_OBJ_BANK,0,SUBTERRANEANLEV2_COL,LEVEL_CLOSED,0,-1,0, 0,0, 0,1100,1100,1200,"PHI",7000,SUB2_STAK,1070,0,
		STR_LEVEL_SUB3,"LEV_SUB3",0,				LEVELID_SUBTERRANEAN4,LEVELID_LABORATORY1,WORLDID_LABORATORY,SUBTERRANEANBOSS_OBJ_BANK,0,SUBTERRANEANMASTER_COL,LEVEL_CLOSED,0,-1,0, 0,0, 0,1100,1100,1050,"AND",7000,SUB3_STAK,900,0,
//		STR_LEVEL_SUBMULTI,"GARDEN1",0,		LEVELID_SUBTERRANEAN6,LEVELID_SUBTERRANEAN1,WORLDID_SUBTERRANEAN,SUBTERRANEANMULTI_OBJ_BANK,0,SUBTERRANEANMULTI_COL,LEVEL_OPEN,0,-1,0, 0,0, 0,1100,1100,60,"SUSIE",7000,
		},
	},

//------------------------------------------------ LABORATORY

	{
	STR_WORLD_LAB,				// description
	WORLDID_LABORATORY,		// world ID
	LABORATORYMASTER_OBJ_BANK,		// master object bank
	LABORATORY_TEX_BANK,		// master texture bank
	WORLD_CLOSED,
	6,						// number of levels
	3,						// number of single player levels
		{ 
		STR_LEVEL_LAB1,"LEV_LAB1",0,		LEVELID_LABORATORY1,LEVELID_LABORATORY2,WORLDID_LABORATORY,LABORATORYLEV1_OBJ_BANK,0,LABORATORYLEV1_COL,LEVEL_CLOSED,0,-1,0, 0,0, 0,1100,1100,950,"CAR",7000,LAB1_STAK,800,0,
		STR_LEVEL_LAB2,"LEV_LAB2",0,		LEVELID_LABORATORY3,LEVELID_SPACE2,WORLDID_SPACE,LABORATORYLEV3_OBJ_BANK,0,LABORATORYLEV3_COL,LEVEL_CLOSED,0,-1,0, 0,0, 0,1100,1100,2000,"ALI",12000,LAB2_STAK,1700,0,
		STR_LEVEL_LAB3,"LEV_LAB3",0,		LEVELID_LABORATORY4,LEVELID_SPACE3,WORLDID_SPACE,LABORATORYBOSSA_OBJ_BANK,0,LABORATORYMASTERA_COL,LEVEL_CLOSED,0,-1,0, 0,0, 0,1100,1100,1700,"ROL",10000,LAB3_STAK,1500,0,
		STR_LEVEL_LABMULTI1,"GARDEN1",0,LEVELID_LABORATORY5,LEVELID_LABORATORY2,WORLDID_LABORATORY,LABORATORYMULTI1_OBJ_BANK,0,LABORATORYMULTI1_COL,LEVEL_OPEN,1,-1,0, 0,0, 0,1100,1100,600,"NIG",25000,LABMULTI1_STAK,3000,0,
		STR_LEVEL_LABMULTI2,"GARDEN1",0,LEVELID_LABORATORY6,LEVELID_LABORATORY2,WORLDID_LABORATORY,LABORATORYMULTI2_OBJ_BANK,0,LABORATORYMULTI2_COL,LEVEL_OPEN,1,-1,0, 0,0, 0,1100,1100,600,"NIG",25000,LABMULTI2_STAK,3000,0,
		STR_LEVEL_LABMULTI3,"GARDEN1",0,LEVELID_LABORATORY7,LEVELID_LABORATORY2,WORLDID_LABORATORY,LABORATORYMULTI3_OBJ_BANK,0,LABORATORYMULTI3_COL,LEVEL_OPEN,1,-1,0, 0,0, 0,1100,1100,600,"NIG",25000,LABMULTI3_STAK,3000,0,
		},
	},

//------------------------------------------------ HALLOWEEN

	{
	STR_WORLD_HALL,					// description
	WORLDID_HALLOWEEN,			// world ID
	HALLOWEENMASTER_OBJ_BANK,			// master object bank
	HALLOWEEN_TEX_BANK,			// master texture bank
	WORLD_CLOSED,
	3,						// number of levels 
	3,						// number of single player levels
		{ 
		STR_LEVEL_HALL1,"LEV_HAL1",0,		LEVELID_HALLOWEEN1,LEVELID_HALLOWEEN2,WORLDID_HALLOWEEN,HALLOWEENLEV1_OBJ_BANK,0,HALLOWEENLEV1_COL,LEVEL_CLOSED,0,-1,0, 0,0, 0,1100,1100,1000,"LOZ",7000,HALLOWEEN1_STAK,900,0,
		STR_LEVEL_HALL2,"LEV_HAL2",0,		LEVELID_HALLOWEEN2,LEVELID_HALLOWEEN3,WORLDID_HALLOWEEN,HALLOWEENLEV2_OBJ_BANK,0,HALLOWEENLEV2_COL,LEVEL_CLOSED,0,-1,0, 0,0, 0,1000,1150,1500,"SCi",7000,HALLOWEEN2_STAK,1300,0,
		STR_LEVEL_SWAMPY3,"LEV_HAL3",0,	LEVELID_HALLOWEEN5,LEVELID_FRONTEND1,WORLDID_FRONTEND,HALLOWEENBOSSB_OBJ_BANK,0,HALLOWEENMASTERB_COL,LEVEL_CLOSED,0,-1,0, 0,0, 0,1100,1100,1200,"JIM",7000,HALLOWEEN3_STAK,1090,0,
//		STR_LEVEL_HALLMULTI,"GARDEN1",0,LEVELID_HALLOWEEN7,LEVELID_HALLOWEEN2,WORLDID_LABORATORY,HALLOWEENMULTI_OBJ_BANK,0,HALLOWEENMULTI_COL,LEVEL_OPEN,0,-1,0, 0,0, 0,1100,1100,60,"BYRON",7000,
		},
	},

	
//------------------------------------------------ SWAMPYWORLD

//	{
//	STR_WORLD_SWAMPY,					// description
//	WORLDID_SWAMPYWORLD,			// world ID
//	SWAMPYWORLDMASTER_OBJ_BANK,			// master object bank
//	SWAMPYWORLD_TEX_BANK,			// master texture bank
//	WORLD_OPEN,
//	4,						// number of levels 
//	4,						// number of single player levels
//		{ 
//		STR_LEVEL_SWAMPY1,"",90,				LEVELID_SWAMPYWORLD3,LEVELID_SWAMPYWORLD4,WORLDID_SWAMPYWORLD,SWAMPYWORLDLEV3_OBJ_BANK,0,SWAMPYWORLDLEV3_COL,LEVEL_OPEN,-1,0, 0,0, 0,1100,1100,190,"SANDRO",7000,
//		STR_LEVEL_SWAMPY2,"HALL3",0,			LEVELID_SWAMPYWORLD4,LEVELID_SWAMPYWORLD5,WORLDID_SWAMPYWORLD,SWAMPYWORLDBOSS_OBJ_BANK,0,SWAMPYWORLDMASTER_COL,LEVEL_OPEN,-1,0, 0,0, 0,1100,1100,120,"MATT",7000,
//		STR_LEVEL_SWAMPY3,"",0,					LEVELID_SWAMPYWORLD5,LEVELID_SWAMPYWORLD6,WORLDID_SWAMPYWORLD,SWAMPYWORLDBOSSB_OBJ_BANK,0,SWAMPYWORLDMASTERB_COL,LEVEL_OPEN,-1,0, 0,0, 0,1100,1100,120,"JIM",7000,
//		STR_WORLD_SWAMPY,"GARDEN1",0,		LEVELID_SWAMPYWORLD6,LEVELID_SUPERRETRO1,WORLDID_SUPERRETRO,SWAMPYWORLDMULTI_OBJ_BANK,0,SWAMPYWORLDMULTI_COL,LEVEL_OPEN,-1,0, 0,0, 0,1100,1100,60,"DAVE",7000,
//		},
//	},


//------------------------------------------------ SUPERRETRO

	{
	STR_WORLD_RETRO,			// description
	WORLDID_SUPERRETRO,		// world ID
	RETROMASTER_OBJ_BANK,	// master object bank
	SUPERRETRO_TEX_BANK,	// master texture bank
	WORLD_OPEN,
	14,						// number of levels
	10,						// number of single player levels
		{ 
		STR_LEVEL_RETRO1,"LEV_RET1",0,		LEVELID_SUPERRETRO1,LEVELID_SUPERRETRO2,WORLDID_SUPERRETRO,RETROLEV1_OBJ_BANK,0,RETROLEV1_COL,LEVEL_OPEN,1,-1,0, 0,0, 0,1100,1100,1000,"RAN",7000,RETRO1_STAK,870,0,
		STR_LEVEL_RETRO2,"LEV_RET1",0,		LEVELID_SUPERRETRO2,LEVELID_SUPERRETRO3,WORLDID_SUPERRETRO,RETROLEV2_OBJ_BANK,0,RETROLEV2_COL,LEVEL_CLOSED,1,-1,0, 0,0, 0,1100,1100,500,"BRU",7000,RETRO2_STAK,440,0,
		STR_LEVEL_RETRO3,"LEV_RET1",0,		LEVELID_SUPERRETRO3,LEVELID_SUPERRETRO4,WORLDID_SUPERRETRO,RETROLEV3_OBJ_BANK,0,RETROLEV3_COL,LEVEL_CLOSED,1,-1,0, 0,0, 0,1100,1100,400,"RAN",7000,RETRO3_STAK,330,0,
		STR_LEVEL_RETRO4,"LEV_RET1",0,		LEVELID_SUPERRETRO4,LEVELID_SUPERRETRO5,WORLDID_SUPERRETRO,RETROLEV4_OBJ_BANK,0,RETROLEV4_COL,LEVEL_CLOSED,1,-1,0, 0,0, 0,1100,1100,1200,"BRU",7000,RETRO4_STAK,1070,0,
		STR_LEVEL_RETRO5,"LEV_RET1",0,		LEVELID_SUPERRETRO5,LEVELID_SUPERRETRO6,WORLDID_SUPERRETRO,RETROLEV5_OBJ_BANK,0,RETROLEV5_COL,LEVEL_CLOSED,1,-1,0, 0,0, 0,1100,1100,600,"JIM",7000,RETRO5_STAK,530,0,
		STR_LEVEL_RETRO6,"LEV_RET1",0,		LEVELID_SUPERRETRO6,LEVELID_SUPERRETRO7,WORLDID_SUPERRETRO,RETROLEV6_OBJ_BANK,0,RETROLEV6_COL,LEVEL_CLOSED,1,-1,0, 0,0, 0,1100,1100,1050,"WUK",7000,RETRO6_STAK,920,0,
		STR_LEVEL_RETRO7,"LEV_RET1",0,		LEVELID_SUPERRETRO7,LEVELID_SUPERRETRO8,WORLDID_SUPERRETRO,RETROLEV7_OBJ_BANK,0,RETROLEV7_COL,LEVEL_CLOSED,1,-1,0, 0,0, 0,1100,1100,550,"JIM",7000,RETRO7_STAK,470,0,
		STR_LEVEL_RETRO8,"LEV_RET1",0,		LEVELID_SUPERRETRO8,LEVELID_SUPERRETRO9,WORLDID_SUPERRETRO,RETROLEV8_OBJ_BANK,0,RETROLEV8_COL,LEVEL_CLOSED,1,-1,0, 0,0, 0,1100,1100,600,"WUK",7000,RETRO8_STAK,510,0,
		STR_LEVEL_RETRO9,"LEV_RET1",0,		LEVELID_SUPERRETRO9,LEVELID_SUPERRETRO10,WORLDID_SUPERRETRO,RETROLEV9_OBJ_BANK,0,RETROLEV9_COL,LEVEL_CLOSED,1,-1,0, 0,0, 0,1100,1100,2100,"JIM",7000,RETRO9_STAK,1800,0,
		STR_LEVEL_RETRO10,"LEV_RET1",0,		LEVELID_SUPERRETRO10,LEVELID_FRONTEND1,WORLDID_FRONTEND,RETROLEV10_OBJ_BANK,0,RETROLEV10_COL,LEVEL_CLOSED,1,-1,0, 0,0, 0,1100,1100,2500,"WUK",7000,RETRO10_STAK,2240,0,
		STR_LEVEL_RETROMULTI1,"SUPER1",0,	LEVELID_SUPERRETRO11,LEVELID_SUPERRETRO2,WORLDID_SUPERRETRO,RETROMULTI1_OBJ_BANK,0,RETROMULTI1_COL,LEVEL_OPEN,1,-1,0, 0,0, 0,1100,1100,600,"BRU",25000,RETROMULTI1_STAK,3000,0,
		STR_LEVEL_RETROMULTI2,"SUPER1",0,	LEVELID_SUPERRETRO12,LEVELID_SUPERRETRO2,WORLDID_SUPERRETRO,RETROMULTI2_OBJ_BANK,0,RETROMULTI2_COL,LEVEL_OPEN,1,-1,0, 0,0, 0,1100,1100,600,"BRU",25000,RETROMULTI2_STAK,3000,0,
//		STR_LEVEL_RETROMULTI3,"SUPER1",0,	LEVELID_SUPERRETRO13,LEVELID_SUPERRETRO2,WORLDID_SUPERRETRO,RETROMULTI3_OBJ_BANK,0,RETROMULTI3_COL,LEVEL_OPEN,0,-1,0, 0,0, 0,1100,1100,60,"BRUCE",12000,
//		STR_LEVEL_RETROMULTI4,"SUPER1",0,	LEVELID_SUPERRETRO14,LEVELID_SUPERRETRO2,WORLDID_SUPERRETRO,RETROMULTI4_OBJ_BANK,0,RETROMULTI4_COL,LEVEL_OPEN,0,-1,0, 0,0, 0,1100,1100,60,"BRUCE",12000,
//		STR_LEVEL_RETROMULTI5,"SUPER1",0,	LEVELID_SUPERRETRO15,LEVELID_SUPERRETRO2,WORLDID_SUPERRETRO,RETROMULTI5_OBJ_BANK,0,RETROMULTI5_COL,LEVEL_OPEN,0,-1,0, 0,0, 0,1100,1100,60,"BRUCE",12000,
//		STR_LEVEL_RETROMULTI3,"SUPER1",0,	LEVELID_SUPERRETRO16,LEVELID_SUPERRETRO2,WORLDID_SUPERRETRO,RETROMULTI6_OBJ_BANK,0,RETROMULTI6_COL,LEVEL_OPEN,0,-1,0, 0,0, 0,1100,1100,60,"BRUCE",12000,RETROMULTI3_STAK,
//		STR_LEVEL_RETROMULTI7,"SUPER1",0,	LEVELID_SUPERRETRO17,LEVELID_SUPERRETRO2,WORLDID_SUPERRETRO,RETROMULTI7_OBJ_BANK,0,RETROMULTI7_COL,LEVEL_OPEN,0,-1,0, 0,0, 0,1100,1100,60,"BRUCE",12000,
//		STR_LEVEL_RETROMULTI8,"SUPER1",0,	LEVELID_SUPERRETRO18,LEVELID_SUPERRETRO2,WORLDID_SUPERRETRO,RETROMULTI8_OBJ_BANK,0,RETROMULTI8_COL,LEVEL_OPEN,0,-1,0, 0,0, 0,1100,1100,60,"BRUCE",12000,
		STR_LEVEL_RETROMULTI3,"SUPER1",0,	LEVELID_SUPERRETRO19,LEVELID_SUPERRETRO2,WORLDID_SUPERRETRO,RETROMULTI9_OBJ_BANK,0,RETROMULTI9_COL,LEVEL_OPEN,1,-1,0, 0,0, 0,1100,1100,600,"BRU",25000,RETROMULTI4_STAK,3000,0,
//		STR_LEVEL_RETROMULTI10,"SUPER1",0,	LEVELID_SUPERRETRO20,LEVELID_SUPERRETRO2,WORLDID_SUPERRETRO,RETROMULTI10_OBJ_BANK,0,RETROMULTI10_COL,LEVEL_OPEN,0,-1,0, 0,0, 0,1100,1100,60,"BRUCE",12000,
		},
	},

//------------------------------------------------

	{
	-1,			// description
	WORLDID_FRONTEND,		// world ID
	FRONTEND_OBJ_BANK,	// master object bank
	FRONTEND_TEX_BANK,	// master texture bank
	WORLD_OPEN,
	5,						// number of levels
	5,						// number of single player levels
		{
		STR_LEVEL_UNNAMED,"GARDEN1",0,		LEVELID_FRONTEND1,LEVELID_FRONTEND1,WORLDID_FRONTEND,FRONTEND1_OBJ_BANK,0,FRONTEND1_COL,LEVEL_OPEN,0,-1,0, 120,120,160,350,6500,600,"MAT",7000,FRONTEND1_STAK,3000,0,
		STR_LEVEL_UNNAMED,"GARDEN1",0,		LEVELID_FRONTEND2,LEVELID_FRONTEND1,WORLDID_FRONTEND,FRONTEND2_OBJ_BANK,0,FRONTEND2_COL,LEVEL_OPEN,0,-1,0, 0,0, 0,1100,1100,600,"MAT",7000,0,3000,0,
		STR_LEVEL_UNNAMED,"GARDEN1",0,		LEVELID_FRONTEND3,LEVELID_FRONTEND1,WORLDID_FRONTEND,FRONTEND3_OBJ_BANK,0,FRONTEND3_COL,LEVEL_OPEN,0,-1,0, 0,0, 0,1100,1100,600,"MAT",7000,0,3000,0,
		STR_LEVEL_TRAINING,"LEV_TRAN",0,	LEVELID_FRONTEND4,LEVELID_GARDEN1,WORLDID_GARDEN,FRONTEND4_OBJ_BANK,0,FRONTEND4_COL,LEVEL_OPEN,0,-1,0, 120,120,160,350,900,600,"MAT",7000,FRONTEND4_STAK,3000,0,
		STR_LEVEL_UNNAMED,"GARDEN1",0,		LEVELID_FRONTEND5,LEVELID_FRONTEND1,WORLDID_FRONTEND,FRONTEND5_OBJ_BANK,0,FRONTEND5_COL,LEVEL_OPEN,0,-1,0, 0,0, 0,1100,1100,600,"MAT",7000,0,3000,0,
		},
	}
};
#endif

#ifdef PC_VERSION
WORLD_VISUAL_DATA origWorldVisualData[MAX_WORLDS] = 
{
//------------------------------------------------ GARDEN
	{
	STR_WORLD_GARDEN,				// description
	WORLDID_GARDEN,			// world ID
	GARDENMASTER_OBJ_BANK,		// master object bank
	GARDEN_TEX_BANK,		// master texture bank
	WORLD_OPEN,
	1,						// number of levels
	1,						// number of single player levels
		{ 
		STR_LEVEL_GARDEN1,	"LEV_GAR1",0,		LEVELID_GARDEN1,LEVELID_ANCIENT1,WORLDID_ANCIENT,GARDENLEV1_OBJ_BANK,0,GARDENLEV1_COL,LEVEL_OPEN,0,WORLDID_ANCIENT,0,  0,0,0,650,780,320,"LOZ",7000,GARDEN1_STAK,280,0,
//		STR_LEVEL_GARDENMULTI,"GARDEN1",0,	LEVELID_GARDEN6,LEVELID_ANCIENT1,WORLDID_ANCIENT,GARDENMULTI_OBJ_BANK,0,GARDENMULTI_COL,LEVEL_OPEN,0,-1,0, 0,0, 0,1100,1100,60,"SIMON",7000,
		},
	},

//------------------------------------------------ ANCIENT

	{
	STR_WORLD_ANCIENT,			// description
	WORLDID_ANCIENT,		// world ID
	ANCIENTMASTER_OBJ_BANK,	// master object bank
	ANCIENT_TEX_BANK,	// master texture bank
	WORLD_CLOSED,
	4,						// number of levels
	3,						// number of single player levels
		{ 
//		STR_LEVEL_ANCIENT1,"ANCIENT1",0,		LEVELID_ANCIENT1,LEVELID_SUBTERRANEAN1,WORLDID_SUBTERRANEAN,ANCIENTLEV1_OBJ_BANK,0,ANCIENTLEV1_COL,LEVEL_OPEN,0,-1,0, 0,0, 0,800,1000,80,"SANDRO",7000,
		STR_LEVEL_ANCIENT1,"LEV_ANC1",0,		LEVELID_ANCIENT1,LEVELID_SUBTERRANEAN1,WORLDID_SUBTERRANEAN,ANCIENTLEV1_OBJ_BANK,0,ANCIENTLEV1_COL,LEVEL_CLOSED,0,-1,0, 0,0, 0,800,1000,600,"SAN",7000,ANCIENTS1_STAK,520,0,
		STR_LEVEL_ANCIENT2,"LEV_ANC2",0,		LEVELID_ANCIENT3,LEVELID_SUBTERRANEAN2,WORLDID_SUBTERRANEAN,ANCIENTLEV3_OBJ_BANK,0,ANCIENTLEV3_COL,LEVEL_CLOSED,0,-1,0, 0,0, 0,800,1100,730,"MAT",7000,ANCIENTS2_STAK,650,0,
		STR_LEVEL_ANCIENT3,"LEV_ANC3",0,		LEVELID_ANCIENT4,LEVELID_ANCIENT3,WORLDID_ANCIENT,ANCIENTBOSS_OBJ_BANK,0,ANCIENTMASTER_COL,LEVEL_CLOSED,0,-1,0, 0,0, 0,1100,1100,520,"JIM",7000,ANCIENTS3_STAK,460,0,
		STR_LEVEL_ANCIENTMULTI,"GARDEN1",0,	LEVELID_ANCIENT6,LEVELID_ANCIENT1,WORLDID_ANCIENT,ANCIENTMULTI_OBJ_BANK,0,ANCIENTMULTI_COL,LEVEL_OPEN,1,-1,0, 0,0, 0,1100,1100,600,"DAV",9000,ANCIENTSMULTI_STAK,3000,0,
		},
	},


//------------------------------------------------ SPACE

	{
	STR_WORLD_SPACE,			// description
	WORLDID_SPACE,		// world ID
	SPACEMASTER_OBJ_BANK,		// master object bank
	SPACE_TEX_BANK,		// master texture bank
	WORLD_CLOSED,
	3,						// number of levels
	3,						// number of single player levels
		{ 
		STR_LEVEL_SPACE1,"LEV_SPA1",0,		LEVELID_SPACE1,LEVELID_LABORATORY3,WORLDID_LABORATORY,SPACELEV1_OBJ_BANK,0,SPACELEV1_COL,LEVEL_CLOSED,0,-1,0, 0,0, 0,500,1100,1300,"BYR",7000,SPACE1_STAK,1150,0,
		STR_LEVEL_SPACE2,"LEV_SPA2",0,		LEVELID_SPACE3,LEVELID_SPACE1,WORLDID_SPACE,SPACELEV3_OBJ_BANK,0,SPACELEV3_COL,LEVEL_CLOSED,0,-1,0, 0,0, 0,1100,1800,950,"RAN",14000,SPACE2_STAK,840,0,
		STR_LEVEL_SPACE3,"LEV_SPA3",0,		LEVELID_SPACE4,LEVELID_HALLOWEEN1,WORLDID_HALLOWEEN,SPACEBOSS_OBJ_BANK,0,SPACEMASTER_COL,LEVEL_CLOSED,0,-1,0, 0,0, 0,1100,1100,1600,"JOF",7000,SPACE3_STAK,1400,0,
//		STR_LEVEL_SPACEMULTI,"SPACE1",0,	LEVELID_SPACE6,LEVELID_LABORATORY1,WORLDID_LABORATORY,SPACEMULTI_OBJ_BANK,0,SPACEMULTI_COL,LEVEL_OPEN,0,-1,0, 0,0, 0,1100,1100,60,"RICHARD",7000,
		},
	},

//------------------------------------------------ CITY

	{
	STR_WORLD_CITY,				// description
	WORLDID_CITY,		// world ID
	CITYMASTER_OBJ_BANK,		// master object bank
	CITY_TEX_BANK,		// master texture bank
	WORLD_OPEN,
	1,						// number of levels
	0,						// number of single player levels
		{ 
//		STR_LEVEL_CITY1,"CITY1",80,			LEVELID_CITY1,LEVELID_CITY2,WORLDID_CITY,CITYLEV1_OBJ_BANK,0,CITYLEV1_COL,LEVEL_OPEN,0,-1,0, 0,0, 0,1100,1100,150,"BRUCE",7000,
//		STR_LEVEL_CITY2,"CITY2",80,			LEVELID_CITY2,LEVELID_CITY3,WORLDID_CITY,CITYLEV2_OBJ_BANK,0,CITYLEV2_COL,LEVEL_OPEN,0,-1,0, 0,0, 0,1100,1100,160,"MIKE",7000,
//		STR_LEVEL_CITY3,"CITY3",90,			LEVELID_CITY3,LEVELID_SUBTERRANEAN1,WORLDID_SUBTERRANEAN,CITYLEV3_OBJ_BANK,0,CITYLEV3_COL,LEVEL_OPEN,0,-1,0, 100,100, 000,350,1100,150,"ANDY",7000,
		STR_LEVEL_CITYMULTI,"GARDEN1",0,	LEVELID_CITY6,LEVELID_CITY6,WORLDID_CITY,CITYMULTI_OBJ_BANK,0,CITYMULTI_COL,LEVEL_OPEN,1,-1,0, 0,0, 0,1100,1100,600,"ALX",7000,CITYMULTI_STAK,3000,0,
		},
	},

//------------------------------------------------ SUBTERRANEAN

	{
	STR_WORLD_SUB,				// description
	WORLDID_SUBTERRANEAN,		// world ID
	SUBTERRANEANMASTER_OBJ_BANK,		// master object bank
	SUBTERRANEAN_TEX_BANK,		// master texture bank
	WORLD_CLOSED,
	3,						// number of levels
	3,						// number of single player levels
		{ 
		STR_LEVEL_SUB1,"LEV_SUB1",0,				LEVELID_SUBTERRANEAN1,LEVELID_ANCIENT3,WORLDID_ANCIENT,SUBTERRANEANLEV1_OBJ_BANK,0,SUBTERRANEANLEV1_COL,LEVEL_CLOSED,0,-1,0, 0,0, 0,1100,1100,950,"KEV",7000,SUB1_STAK,840,0,
		STR_LEVEL_SUB2,"LEV_SUB2",0,				LEVELID_SUBTERRANEAN2,LEVELID_SUBTERRANEAN3,WORLDID_SUBTERRANEAN,SUBTERRANEANLEV2_OBJ_BANK,0,SUBTERRANEANLEV2_COL,LEVEL_CLOSED,0,-1,0, 0,0, 0,1100,1100,800,"PHI",7000,SUB2_STAK,700,0,
		STR_LEVEL_SUB3,"LEV_SUB3",0,				LEVELID_SUBTERRANEAN4,LEVELID_LABORATORY1,WORLDID_LABORATORY,SUBTERRANEANBOSS_OBJ_BANK,0,SUBTERRANEANMASTER_COL,LEVEL_CLOSED,0,-1,0, 0,0, 0,1100,1100,550,"AND",7000,SUB3_STAK,450,0,
//		STR_LEVEL_SUBMULTI,"GARDEN1",0,		LEVELID_SUBTERRANEAN6,LEVELID_SUBTERRANEAN1,WORLDID_SUBTERRANEAN,SUBTERRANEANMULTI_OBJ_BANK,0,SUBTERRANEANMULTI_COL,LEVEL_OPEN,0,-1,0, 0,0, 0,1100,1100,60,"SUSIE",7000,
		},
	},

//------------------------------------------------ LABORATORY

	{
	STR_WORLD_LAB,				// description
	WORLDID_LABORATORY,		// world ID
	LABORATORYMASTER_OBJ_BANK,		// master object bank
	LABORATORY_TEX_BANK,		// master texture bank
	WORLD_CLOSED,
	6,						// number of levels
	3,						// number of single player levels
		{ 
		STR_LEVEL_LAB1,"LEV_LAB1",0,		LEVELID_LABORATORY1,LEVELID_LABORATORY2,WORLDID_LABORATORY,LABORATORYLEV1_OBJ_BANK,0,LABORATORYLEV1_COL,LEVEL_CLOSED,0,-1,0, 0,0, 0,1100,1100,700,"CAR",7000,LAB1_STAK,600,0,
		STR_LEVEL_LAB2,"LEV_LAB2",0,		LEVELID_LABORATORY3,LEVELID_SPACE2,WORLDID_SPACE,LABORATORYLEV3_OBJ_BANK,0,LABORATORYLEV3_COL,LEVEL_CLOSED,0,-1,0, 0,0, 0,1100,1100,1300,"ALI",12000,LAB2_STAK,1150,0,
		STR_LEVEL_LAB3,"LEV_LAB3",0,		LEVELID_LABORATORY4,LEVELID_SPACE3,WORLDID_SPACE,LABORATORYBOSSA_OBJ_BANK,0,LABORATORYMASTERA_COL,LEVEL_CLOSED,0,-1,0, 0,0, 0,1100,1100,1300,"ROL",10000,LAB3_STAK,1150,0,
		STR_LEVEL_LABMULTI1,"GARDEN1",0,LEVELID_LABORATORY5,LEVELID_LABORATORY2,WORLDID_LABORATORY,LABORATORYMULTI1_OBJ_BANK,0,LABORATORYMULTI1_COL,LEVEL_OPEN,1,-1,0, 0,0, 0,1100,1100,600,"NIG",25000,LABMULTI1_STAK,3000,0,
		STR_LEVEL_LABMULTI2,"GARDEN1",0,LEVELID_LABORATORY6,LEVELID_LABORATORY2,WORLDID_LABORATORY,LABORATORYMULTI2_OBJ_BANK,0,LABORATORYMULTI2_COL,LEVEL_OPEN,1,-1,0, 0,0, 0,1100,1100,600,"NIG",25000,LABMULTI2_STAK,3000,0,
		STR_LEVEL_LABMULTI3,"GARDEN1",0,LEVELID_LABORATORY7,LEVELID_LABORATORY2,WORLDID_LABORATORY,LABORATORYMULTI3_OBJ_BANK,0,LABORATORYMULTI3_COL,LEVEL_OPEN,1,-1,0, 0,0, 0,1100,1100,600,"NIG",25000,LABMULTI3_STAK,3000,0,
		},
	},

//------------------------------------------------ HALLOWEEN

	{
	STR_WORLD_HALL,					// description
	WORLDID_HALLOWEEN,			// world ID
	HALLOWEENMASTER_OBJ_BANK,			// master object bank
	HALLOWEEN_TEX_BANK,			// master texture bank
	WORLD_CLOSED,
	3,						// number of levels 
	3,						// number of single player levels
		{ 
		STR_LEVEL_HALL1,"LEV_HAL1",0,		LEVELID_HALLOWEEN1,LEVELID_HALLOWEEN2,WORLDID_HALLOWEEN,HALLOWEENLEV1_OBJ_BANK,0,HALLOWEENLEV1_COL,LEVEL_CLOSED,0,-1,0, 0,0, 0,1100,1100,850,"LOZ",7000,HALLOWEEN1_STAK,700,0,
		STR_LEVEL_HALL2,"LEV_HAL2",0,		LEVELID_HALLOWEEN2,LEVELID_HALLOWEEN3,WORLDID_HALLOWEEN,HALLOWEENLEV2_OBJ_BANK,0,HALLOWEENLEV2_COL,LEVEL_CLOSED,0,-1,0, 0,0, 0,1000,1150,1250,"SCi",7000,HALLOWEEN2_STAK,1070,0,
		STR_LEVEL_SWAMPY3,"LEV_HAL3",0,	LEVELID_HALLOWEEN5,LEVELID_FRONTEND1,WORLDID_FRONTEND,HALLOWEENBOSSB_OBJ_BANK,0,HALLOWEENMASTERB_COL,LEVEL_CLOSED,0,-1,0, 0,0, 0,1100,1100,750,"JIM",7000,HALLOWEEN3_STAK,630,0,
//		STR_LEVEL_HALLMULTI,"GARDEN1",0,LEVELID_HALLOWEEN7,LEVELID_HALLOWEEN2,WORLDID_LABORATORY,HALLOWEENMULTI_OBJ_BANK,0,HALLOWEENMULTI_COL,LEVEL_OPEN,0,-1,0, 0,0, 0,1100,1100,60,"BYRON",7000,
		},
	},

	
//------------------------------------------------ SWAMPYWORLD

//	{
//	STR_WORLD_SWAMPY,					// description
//	WORLDID_SWAMPYWORLD,			// world ID
//	SWAMPYWORLDMASTER_OBJ_BANK,			// master object bank
//	SWAMPYWORLD_TEX_BANK,			// master texture bank
//	WORLD_OPEN,
//	4,						// number of levels 
//	4,						// number of single player levels
//		{ 
//		STR_LEVEL_SWAMPY1,"",90,				LEVELID_SWAMPYWORLD3,LEVELID_SWAMPYWORLD4,WORLDID_SWAMPYWORLD,SWAMPYWORLDLEV3_OBJ_BANK,0,SWAMPYWORLDLEV3_COL,LEVEL_OPEN,-1,0, 0,0, 0,1100,1100,190,"SANDRO",7000,
//		STR_LEVEL_SWAMPY2,"HALL3",0,			LEVELID_SWAMPYWORLD4,LEVELID_SWAMPYWORLD5,WORLDID_SWAMPYWORLD,SWAMPYWORLDBOSS_OBJ_BANK,0,SWAMPYWORLDMASTER_COL,LEVEL_OPEN,-1,0, 0,0, 0,1100,1100,120,"MATT",7000,
//		STR_LEVEL_SWAMPY3,"",0,					LEVELID_SWAMPYWORLD5,LEVELID_SWAMPYWORLD6,WORLDID_SWAMPYWORLD,SWAMPYWORLDBOSSB_OBJ_BANK,0,SWAMPYWORLDMASTERB_COL,LEVEL_OPEN,-1,0, 0,0, 0,1100,1100,120,"JIM",7000,
//		STR_WORLD_SWAMPY,"GARDEN1",0,		LEVELID_SWAMPYWORLD6,LEVELID_SUPERRETRO1,WORLDID_SUPERRETRO,SWAMPYWORLDMULTI_OBJ_BANK,0,SWAMPYWORLDMULTI_COL,LEVEL_OPEN,-1,0, 0,0, 0,1100,1100,60,"DAVE",7000,
//		},
//	},


//------------------------------------------------ SUPERRETRO

	{
	STR_WORLD_RETRO,			// description
	WORLDID_SUPERRETRO,		// world ID
	RETROMASTER_OBJ_BANK,	// master object bank
	SUPERRETRO_TEX_BANK,	// master texture bank
	WORLD_OPEN,
	14,						// number of levels
	10,						// number of single player levels
		{ 
		STR_LEVEL_RETRO1,"LEV_RET1",0,		LEVELID_SUPERRETRO1,LEVELID_SUPERRETRO2,WORLDID_SUPERRETRO,RETROLEV1_OBJ_BANK,0,RETROLEV1_COL,LEVEL_OPEN,1,-1,0, 0,0, 0,1100,1100,500,"RAN",7000,RETRO1_STAK,410,0,
		STR_LEVEL_RETRO2,"LEV_RET2",0,		LEVELID_SUPERRETRO2,LEVELID_SUPERRETRO3,WORLDID_SUPERRETRO,RETROLEV2_OBJ_BANK,0,RETROLEV2_COL,LEVEL_CLOSED,1,-1,0, 0,0, 0,1100,1100,450,"BRU",7000,RETRO2_STAK,370,0,
		STR_LEVEL_RETRO3,"LEV_RET3",0,		LEVELID_SUPERRETRO3,LEVELID_SUPERRETRO4,WORLDID_SUPERRETRO,RETROLEV3_OBJ_BANK,0,RETROLEV3_COL,LEVEL_CLOSED,1,-1,0, 0,0, 0,1100,1100,300,"RAN",7000,RETRO3_STAK,260,0,
		STR_LEVEL_RETRO4,"LEV_RET4",0,		LEVELID_SUPERRETRO4,LEVELID_SUPERRETRO5,WORLDID_SUPERRETRO,RETROLEV4_OBJ_BANK,0,RETROLEV4_COL,LEVEL_CLOSED,1,-1,0, 0,0, 0,1100,1100,850,"BRU",7000,RETRO4_STAK,710,0,
		STR_LEVEL_RETRO5,"LEV_RET5",0,		LEVELID_SUPERRETRO5,LEVELID_SUPERRETRO6,WORLDID_SUPERRETRO,RETROLEV5_OBJ_BANK,0,RETROLEV5_COL,LEVEL_CLOSED,1,-1,0, 0,0, 0,1100,1100,500,"JIM",7000,RETRO5_STAK,450,0,
		STR_LEVEL_RETRO6,"LEV_RET6",0,		LEVELID_SUPERRETRO6,LEVELID_SUPERRETRO7,WORLDID_SUPERRETRO,RETROLEV6_OBJ_BANK,0,RETROLEV6_COL,LEVEL_CLOSED,1,-1,0, 0,0, 0,1100,1100,650,"WUK",7000,RETRO6_STAK,580,0,
		STR_LEVEL_RETRO7,"LEV_RET7",0,		LEVELID_SUPERRETRO7,LEVELID_SUPERRETRO8,WORLDID_SUPERRETRO,RETROLEV7_OBJ_BANK,0,RETROLEV7_COL,LEVEL_CLOSED,1,-1,0, 0,0, 0,1100,1100,400,"JIM",7000,RETRO7_STAK,330,0,
		STR_LEVEL_RETRO8,"LEV_RET8",0,		LEVELID_SUPERRETRO8,LEVELID_SUPERRETRO9,WORLDID_SUPERRETRO,RETROLEV8_OBJ_BANK,0,RETROLEV8_COL,LEVEL_CLOSED,1,-1,0, 0,0, 0,1100,1100,650,"WUK",7000,RETRO8_STAK,580,0,
		STR_LEVEL_RETRO9,"LEV_RET9",0,		LEVELID_SUPERRETRO9,LEVELID_SUPERRETRO10,WORLDID_SUPERRETRO,RETROLEV9_OBJ_BANK,0,RETROLEV9_COL,LEVEL_CLOSED,1,-1,0, 0,0, 0,1100,1100,1800,"JIM",7000,RETRO9_STAK,1600,0,
		STR_LEVEL_RETRO10,"LEV_RET10",0,	LEVELID_SUPERRETRO10,LEVELID_FRONTEND1,WORLDID_FRONTEND,RETROLEV10_OBJ_BANK,0,RETROLEV10_COL,LEVEL_CLOSED,1,-1,0, 0,0, 0,1100,1100,1200,"WUK",7000,RETRO10_STAK,1030,0,
		STR_LEVEL_RETROMULTI1,"SUPER1",0,	LEVELID_SUPERRETRO11,LEVELID_SUPERRETRO2,WORLDID_SUPERRETRO,RETROMULTI1_OBJ_BANK,0,RETROMULTI1_COL,LEVEL_OPEN,1,-1,0, 0,0, 0,1100,1100,600,"BRU",25000,RETROMULTI1_STAK,3000,0,
		STR_LEVEL_RETROMULTI2,"SUPER1",0,	LEVELID_SUPERRETRO12,LEVELID_SUPERRETRO2,WORLDID_SUPERRETRO,RETROMULTI2_OBJ_BANK,0,RETROMULTI2_COL,LEVEL_OPEN,1,-1,0, 0,0, 0,1100,1100,600,"BRU",25000,RETROMULTI2_STAK,3000,0,
//		STR_LEVEL_RETROMULTI3,"SUPER1",0,	LEVELID_SUPERRETRO13,LEVELID_SUPERRETRO2,WORLDID_SUPERRETRO,RETROMULTI3_OBJ_BANK,0,RETROMULTI3_COL,LEVEL_OPEN,0,-1,0, 0,0, 0,1100,1100,60,"BRUCE",12000,
//		STR_LEVEL_RETROMULTI4,"SUPER1",0,	LEVELID_SUPERRETRO14,LEVELID_SUPERRETRO2,WORLDID_SUPERRETRO,RETROMULTI4_OBJ_BANK,0,RETROMULTI4_COL,LEVEL_OPEN,0,-1,0, 0,0, 0,1100,1100,60,"BRUCE",12000,
//		STR_LEVEL_RETROMULTI5,"SUPER1",0,	LEVELID_SUPERRETRO15,LEVELID_SUPERRETRO2,WORLDID_SUPERRETRO,RETROMULTI5_OBJ_BANK,0,RETROMULTI5_COL,LEVEL_OPEN,0,-1,0, 0,0, 0,1100,1100,60,"BRUCE",12000,
//		STR_LEVEL_RETROMULTI3,"SUPER1",0,	LEVELID_SUPERRETRO16,LEVELID_SUPERRETRO2,WORLDID_SUPERRETRO,RETROMULTI6_OBJ_BANK,0,RETROMULTI6_COL,LEVEL_OPEN,0,-1,0, 0,0, 0,1100,1100,60,"BRUCE",12000,RETROMULTI3_STAK,
//		STR_LEVEL_RETROMULTI7,"SUPER1",0,	LEVELID_SUPERRETRO17,LEVELID_SUPERRETRO2,WORLDID_SUPERRETRO,RETROMULTI7_OBJ_BANK,0,RETROMULTI7_COL,LEVEL_OPEN,0,-1,0, 0,0, 0,1100,1100,60,"BRUCE",12000,
//		STR_LEVEL_RETROMULTI8,"SUPER1",0,	LEVELID_SUPERRETRO18,LEVELID_SUPERRETRO2,WORLDID_SUPERRETRO,RETROMULTI8_OBJ_BANK,0,RETROMULTI8_COL,LEVEL_OPEN,0,-1,0, 0,0, 0,1100,1100,60,"BRUCE",12000,
		STR_LEVEL_RETROMULTI3,"SUPER1",0,	LEVELID_SUPERRETRO19,LEVELID_SUPERRETRO2,WORLDID_SUPERRETRO,RETROMULTI9_OBJ_BANK,0,RETROMULTI9_COL,LEVEL_OPEN,1,-1,0, 0,0, 0,1100,1100,600,"BRU",25000,RETROMULTI4_STAK,3000,0,
//		STR_LEVEL_RETROMULTI10,"SUPER1",0,	LEVELID_SUPERRETRO20,LEVELID_SUPERRETRO2,WORLDID_SUPERRETRO,RETROMULTI10_OBJ_BANK,0,RETROMULTI10_COL,LEVEL_OPEN,0,-1,0, 0,0, 0,1100,1100,60,"BRUCE",12000,
		},
	},

//------------------------------------------------

	{
	-1,			// description
	WORLDID_FRONTEND,		// world ID
	FRONTEND_OBJ_BANK,	// master object bank
	FRONTEND_TEX_BANK,	// master texture bank
	WORLD_CLOSED,
	5,						// number of levels
	5,						// number of single player levels
		{
		STR_LEVEL_UNNAMED,"GARDEN1",0,		LEVELID_FRONTEND1,LEVELID_FRONTEND1,WORLDID_FRONTEND,FRONTEND1_OBJ_BANK,0,FRONTEND1_COL,LEVEL_OPEN,0,-1,0, 120,120,160,350,6500,600,"MAT",7000,FRONTEND1_STAK,3000,0,
		STR_LEVEL_UNNAMED,"GARDEN1",0,		LEVELID_FRONTEND2,LEVELID_FRONTEND1,WORLDID_FRONTEND,FRONTEND2_OBJ_BANK,0,FRONTEND2_COL,LEVEL_OPEN,0,-1,0, 0,0, 0,1100,1100,600,"MAT",7000,0,3000,0,
		STR_LEVEL_UNNAMED,"GARDEN1",0,		LEVELID_FRONTEND3,LEVELID_FRONTEND1,WORLDID_FRONTEND,FRONTEND3_OBJ_BANK,0,FRONTEND3_COL,LEVEL_OPEN,0,-1,0, 0,0, 0,1100,1100,600,"MAT",7000,0,3000,0,
		STR_LEVEL_TRAINING,"LEV_TRAN",0,	LEVELID_FRONTEND4,LEVELID_GARDEN1,WORLDID_GARDEN,FRONTEND4_OBJ_BANK,0,FRONTEND4_COL,LEVEL_OPEN,0,-1,0, 120,120,160,350,900,600,"MAT",7000,FRONTEND4_STAK,3000,0,
		STR_LEVEL_UNNAMED,"GARDEN1",0,		LEVELID_FRONTEND5,LEVELID_FRONTEND1,WORLDID_FRONTEND,FRONTEND5_OBJ_BANK,0,FRONTEND5_COL,LEVEL_OPEN,0,-1,0, 0,0, 0,1100,1100,600,"MAT",7000,0,3000,0,
		},
	},

//------------------------------------------------

	{
	-1,
	WORLDID_TEST,
	CITYMASTER_OBJ_BANK,
	CITY_TEX_BANK,
	WORLD_CLOSED,
	6, 6,
		{
		STR_LEVEL_PCMULTI1,"GARDEN1",0,	4,	3,	WORLDID_TEST, TEST4_OBJ_BANK, 0, TEST4_COL, LEVEL_OPEN, 0,-1,0, 120,120,160,350,6500,60,"MOO",7000,-1,300,0,
		STR_LEVEL_PCMULTI2,"GARDEN1",0,	2,	1,	WORLDID_TEST, TEST2_OBJ_BANK, 0, TEST2_COL, LEVEL_OPEN, 0,-1,0, 120,120,160,350,6500,60,"MOO",7000,-1,300,0,
		STR_LEVEL_PCMULTI3,"GARDEN1",0,	6,	5,	WORLDID_TEST, TEST6_OBJ_BANK, 0, TEST6_COL, LEVEL_OPEN, 0,-1,0, 120,120,160,350,6500,60,"MOO",7000,-1,300,0,
		STR_LEVEL_PCMULTI4,"GARDEN1",0,	5,	4,	WORLDID_TEST, TEST5_OBJ_BANK, 0, TEST5_COL, LEVEL_OPEN, 0,-1,0, 120,120,160,350,6500,60,"MOO",7000,-1,300,0,
		},
	},
};
#endif


// debug print. wait for start button pressed before we continue
void PrintDebugMessage(char *message)
{
	int	i;

	for(i=0;i<120;i++)
	{
		kmBeginScene(&kmSystemConfig);
		kmBeginPass(&vertexBufferDesc);

		fontPrint(font, 10-256,0, message, 255,255,255);

		kmEndPass(&vertexBufferDesc);
					
		kmRender(KM_RENDER_FLIP);
		kmEndScene(&kmSystemConfig);
	}
}



WORLD_VISUAL_DATA worldVisualData[MAX_WORLDS];

/*	--------------------------------------------------------------------------------
	Function		: LoadVisualBanksForWorld
	Purpose			: loads the relevant object and texture banks for a world
	Parameters		: unsigned long,unsigned long
	Returns			: void
	Info			: 
*/
void LoadVisualBanksForWorld(unsigned long worldID,unsigned long levelID)
{
#ifndef  PSX_VERSION
	MDX_ACTOR *tActor;
#endif
	unsigned long i;
	long objBankToUse;
	long texBankToUse;

	objBankToUse = worldVisualData[worldID].masterObjectBank;
	texBankToUse = worldVisualData[worldID].masterTextureBank;

	// Contains frogger and froglet - probably quite important
	LoadObjectBank ( INGAMEGENERIC_OBJ_BANK );

	// Load multiple frogs for multiplayer modes - note the lovely comparison(0/1) multiplied by the number of frogs
	// to get an offset for multiplayer :)
#ifdef PSX_VERSION
	for( i=0; i<NUM_FROGS; i++ )
		LoadStakFile ( FROGGER_STAK + player[i].character + ((gameState.multi != SINGLEPLAYER)*FROG_NUMFROGS) );
#endif

	for( i=0; i<NUM_FROGS; i++ )
		LoadObjectBank( FROGGER_OBJ_BANK + player[i].character + ((gameState.multi != SINGLEPLAYER)*FROG_NUMFROGS) );

	LoadTextureBank(texBankToUse);
	LoadObjectBank(objBankToUse);

	if(worldVisualData[worldID].levelVisualData[levelID].collBank > -1)
	{
		if(worldVisualData[worldID].levelVisualData[levelID].objectBankToUse > 0)
			LoadObjectBank(worldVisualData[worldID].levelVisualData[levelID].objectBankToUse);
	}

#ifndef PSX_VERSION
	if( (tActor = CreateActor("world.obe",INIT_ANIMATION)) )
	{
		world = ConvertActorToLandscape(tActor);
		FreeActor(&tActor);
	}
#endif
}

void UpdateCompletedLevel(unsigned long worldID,unsigned long levelID)
{
	if (levelID<3)
		worldVisualData[worldID].levelVisualData[levelID+1].levelOpen = LEVEL_OPEN;
}


#ifdef PSX_VERSION
void InitLoadingScreen( const char *filename )
{
	SetProgressBar(0);

	// JH: Lets load up the backdrop before we do any thing
	InitBackdrop(filename);
//	InitBackdrop("ARTWORK00");

	SetCurrentDisplayPage ( 1, 0 );

	// JH: And now let's draw it so that it goes straight to the screen, hence the 1.....
	DrawBackDrop(0, 1);
	DrawLoadingBar(0);

	SendOTDisp();

//ma	displayPage[0].drawenv.isbg = displayPage[1].drawenv.isbg = 0;
}

void UpdateLoadingScreen( short addprog )
{
	StepProgressBar(addprog);

	SetCurrentDisplayPage ( 1, 0 );

	// JH: And now let's draw it so that it goes straight to the screen, hence the 1.....
	DrawLoadingBar(0);

	SendOTDisp();
}

void FreeLoadingScreen( )
{
//	ResetDrawingEnvironment();

	FreeBackdrop();
}
#endif

/* --------------------------------------------------------------------------------
	Programmer	: Matthew Cloy
	Function	: InitLevel
	Purpose		:
	Parameters	: unsigned long , unsigned long
	Returns		: void 
*/
extern unsigned long actTickCountModifier;
extern unsigned long actTickCount;

int loadingLevel = NO;
long numLevelsPlayed = 0;
extern short numLives[3];
void InitLevel(unsigned long worldID,unsigned long levelID)
{
	int 		i,temp;
	FVECTOR 	tempPos;
	GAMETILE 	*tempTile;
	PSIMODEL 	*psiModel;
	char		buffer[32];
	unsigned long newWorldID = worldID;
	unsigned long newLevelID = levelID;

	acSystemDelay(500000);
	acSystemSetMasterVolume(15);
	acSystemDelay(500000);

	// *ASL* 17/08/2000 - Make sure the game quitting level is zero
	quittingLevel = 0;
	saveInfo.saveStage = SAVEMENU_COMPLETE;

	// JH : Turn on, the loading screen.
#ifdef PC_VERSION
	pFrameModifier = 0;
#endif
	numLevelsPlayed++;

	player[0].worldNum = newWorldID;
	player[0].levelNum = newLevelID;

	if((newWorldID == WORLDID_FRONTEND) &&(newLevelID == LEVELID_FRONTEND1))
	{
		player[0].character = FROG_FROGGER;

		// *ASL* 12/08/2000 - Set frog logo active for at least n secs in the frontend
		GTInit(&frogLogoTimer, FROG_LOGO_ACTIVE_SECS);
	}
			
#ifdef PC_VERSION
	dp("                                                                                 %lu Levels Played\n",numLevelsPlayed);
#endif

	// ------ Free existing data and setup for loading ------------
#ifdef PSX_VERSION
	//jiggledVerts = MALLOC0 ( sizeof ( SVECTOR ) * 700 );

//ma	SpuSetKey(SPU_OFF,0xffffff);
#endif
	loadingLevel = YES;
	FreeAllLists();
	loadingLevel = NO;

#ifndef NTSC_VERSION
	// handle a soft reset during story fmv
	if((player[0].worldNum != newWorldID)||(player[0].levelNum != newLevelID))
	{
		newWorldID = player[0].worldNum;
		newLevelID = player[0].levelNum;
		GTInit(&frogLogoTimer, FROG_LOGO_ACTIVE_SECS);
	}
#endif

#ifdef PSX_VERSION
	oldActor.psiData.object = NULL;
#endif

	restartingLevel = NO;

/*	if (gameState.mode == FRONTEND_MODE)
	{
		InitTextOverlayLinkedList(200);
	}
	else
	{
		InitTextOverlayLinkedList(40);
	}

	InitSpriteOverlayLinkedList();
*/
//#ifdef PSX_VERSION
//	loadingInit ( worldID, levelID );
//#endif
	
//	memoryShow();

#ifdef NTSC_VERSION
	InitLoadingScreen( "LOADINGUS" );
#else
	InitLoadingScreen( "LOADINGEU" );
#endif

	UpdateLoadingScreen( 10 );

	lastActFrameCount = 0;
	actFrameCount = 0;
	frameCount = 1;

#ifdef PC_VERSION
	InitTiming(60);
#endif
#ifdef PSX_VERSION		
	psiInitialise(100);

//	psiInitLights();
//	psiSetAmbient(128,128,128);
//	psiRegisterDrawFunction(LSCAPE_DrawSortedPrimitives);
//	psiRegisterDrawFunction2(customDrawPrimitives2);
	InitTextureAnimLinkedList();
#endif


	UpdateLoadingScreen( 10 );

	if ((gameState.mode != FRONTEND_MODE) && (gameState.multi == SINGLEPLAYER) && (gameState.single == STORY_MODE)) // - hello yes, I am testing
		StoryStartLevel();

	// ------ Initialise lists ------------

	InitSpriteList();
#ifdef PC_VERSION
	InitSpriteSortArray();
#endif
	InitSampleList();
	InitAmbientSoundList();
	
	
	// ------ Load data from disk ------------

	LoadTextureBank ( INGAMEGENERIC_TEX_BANK );
	
	if (useAudio)
		LoadSfx(newWorldID);

	UpdateLoadingScreen( 20 );

#ifdef PSX_VERSION
	// JH: Here we load the super new large file, which contains all level info.
	LoadStakFile ( worldVisualData[newWorldID].levelVisualData[newLevelID].stakFileToUse );
#endif

#ifdef PSX_VERSION
	LoadStakFile ( GENERIC_STAK );
#endif

	LoadMapBank(worldVisualData[newWorldID].levelVisualData[newLevelID].collBank);

	LoadVisualBanksForWorld ( newWorldID, newLevelID );

	UpdateLoadingScreen( 20 );


	// ------ Initialise more lists ------------

	InitSpecFXList();
	InitParticleList( );

	// ------ Populate game lists ------------

#ifdef PSX_VERSION
	fontInitButtonSprites();
	LoadTextureAnimBank ( INGAMEGENERIC_TEX_BANK );
	LoadTextureAnimBank ( worldVisualData [ newWorldID ].masterTextureBank );
//	InitWaterLinkedList();
	InitScenicObjLinkedList();
#endif

#ifdef PC_VERSION
	PTTextureLoad();
#endif

	InitBabyList( TRUE );
	InitEnemyLinkedList();
	InitPlatformLinkedList();
	InitGaribList();
	InitTriggerList();

	CreateFrogger(1,1);
	CreateLevelObjects ( newWorldID, newLevelID );

	InitTongues( );

	UpdateLoadingScreen( 15 );
	
	//utilPrintf("Loading............\n");

	fog.r = worldVisualData[newWorldID].levelVisualData[newLevelID].fogR;
	fog.g = worldVisualData[newWorldID].levelVisualData[newLevelID].fogG;
	fog.b = worldVisualData[newWorldID].levelVisualData[newLevelID].fogB;
	fog.min = worldVisualData[newWorldID].levelVisualData[newLevelID].fogNearDist;
	fog.max = worldVisualData[newWorldID].levelVisualData[newLevelID].farClip;
//	fog.max = worldVisualData[newWorldID].levelVisualData[newLevelID].fogFarDist;
	
#ifdef PC_VERSION
	dp("Fog to c(%lu,%lu,%lu) from %lu\n",fog.r,fog.g,fog.b,fog.min);
#endif

	LoadLevelEntities( worldVisualData[newWorldID].worldID, worldVisualData[newWorldID].levelVisualData[newLevelID].levelID );

#ifdef PSX_VERSION
	ScreenFade(255,0,30);
	keepFade = YES;
#endif

#ifdef PSX_VERSION
	if ( (newWorldID == 1 && newLevelID == 5) )//||
/*		   (worldID == 1 && levelID == 5) ||
			 (worldID == 3 && levelID == 5) ||
			 (worldID == 5 && levelID == 4) || 
			 (worldID == 5 && levelID == 5) || 
			 (worldID == 5 && levelID == 6) || 
			 (worldID == 7 && levelID == 10)|| 
			 (worldID == 7 && levelID == 11)|| 
			 (worldID == 7 && levelID == 15)|| 
			 (worldID == 7 && levelID == 18)|| */
//			 (worldID == 1 && levelID == 5)) 
	{
		utilPrintf("World   %d : %d\n", newWorldID, newLevelID );
	}
	else
	{
		LoadLevelScript( worldVisualData[newWorldID].worldID, worldVisualData[newWorldID].levelVisualData[newLevelID].levelID );
	}
	// ENDIF

#else
	LoadLevelScript( worldVisualData[newWorldID].worldID, worldVisualData[newWorldID].levelVisualData[newLevelID].levelID );
#endif


	UpdateLoadingScreen( 20 );

	if (useAudio)
		LoadSfxMapping(newWorldID,newLevelID);

	InitInGameTextOverlays(newWorldID,newLevelID);

//	ResetCamera( );
//	InitCamera();


//	if( gameState.multi != SINGLEPLAYER )
//	{
//		ReinitialiseMultiplayer( );
//		ResetMultiplayer( );
//	}

	// ------ Reset miscellaneous pieces of data ------------

	// Stuff that used to be in RunGameLoop
	if((gameState.mode != DEMO_MODE) && (gameState.single != STORY_MODE) && (gameState.mode != FRONTEND_MODE))
		player[0].lives = numLives[gameState.difficulty];

//	player[0].score				= 0;
	player[0].spawnTimer		= 0;
	player[0].spawnScoreLevel	= 1;
	GTInit( &scoreTimer, 90 );
	GTInit( &screenSaveTimer, PAUSEFADETIMESECS );

	if( newWorldID == WORLDID_FRONTEND || gameState.multi != SINGLEPLAYER )
	{
		garibCount->draw = 0;
		creditCount->draw = 0;
		countdownTimer = 0;

		i = numBabies;
		while(i--)
			babyIcons[i]->draw = 0;

		if((newWorldID == WORLDID_FRONTEND) && (newLevelID == LEVELID_FRONTEND1))
		{
			NUM_FROGS = 1;
			gameState.multi = SINGLEPLAYER;

//			flogo[0] = CreateAndAddSpriteOverlay(1254,2176,"FROGGER2",1638,2048,255,0) ;
//			flogo[0]->speed = 81920;
//			fadingLogos = 0;
		}
	}

	// ---- Set up any other miscellaneous level variables

#ifdef PSX_VERSION
	psiAllocWorkspace();
	AllowPsiDestroy = 1;

//	InitWater();

#else
	InitTiming(60);
#endif

	actFrameCount = 0;
	drawLandscape = 1;

	UpdateLoadingScreen( 100 );

		// debug
//ma		PrintDebugMessage("Before Free Loading Screen");

	FreeLoadingScreen( );

		// debug
//ma		PrintDebugMessage("Done Free Loading Screen");

#ifdef PC_VERSION
	ScreenFade(0,0,1);
	keepFade = 1;
#endif

	if((newWorldID == WORLDID_FRONTEND) && (newLevelID == LEVELID_FRONTEND4))
		InitTrainingMode();
	else
		train = 0;

	// ds - had to move this here so PrepareSong doesn't break (PSX)

	if (gameState.mode == DEMO_MODE)
		LoadDemoFile(newWorldID, newLevelID);

// JH : #ifdefed because we need a cd for this to work, so uncomment when we have one.....................
#ifdef PC_VERSION
	if(useAudio)
		PrepareSong((short)newWorldID, 1);		// loop track
#else
//	bb_InitXA();
//	if(useAudio && XAgetStatus())
//		PrepareSong((short)worldID,1);
//	displayPage[0].drawenv.isbg = displayPage[1].drawenv.isbg = 1;
#endif

	//memoryShow();
	//memoryShowStats();

		// debug
//ma		PrintDebugMessage("Before UnPauseAudio");

	UnPauseAudio();

		// debug
//ma		PrintDebugMessage("After UnPauseAudio");

	SetMusicVolume();

		// debug
//ma		PrintDebugMessage("After SetMusicVolume");

	player[0].oldLives = player[0].lives;

#ifdef PSX_VERSION
	//sb wait for screen to fade to black!!
//ma	while(fadingOut)
//	{
//		IQUATERNION squat = {0,0,0,1};
//		MATRIX dmatrix;
//
//		quaternionGetMatrix(&squat,&dmatrix);
//	}
//ma	loadingFree();
#endif

		// debug
//ma		PrintDebugMessage("Before ScreenFade");

	ScreenFade(0,255,30);

		// debug
//ma		PrintDebugMessage("After ScreenFade");

	keepFade = 0;
	startCam = 1;

		// debug
//ma		PrintDebugMessage("Before GTInit");

	GTInit( &endLevelTimer, 0 );

	if( gameState.multi != SINGLEPLAYER )
	{
		// debug
//ma		PrintDebugMessage("Before ReInitialiseBeforeMultiplayer");

		ReinitialiseMultiplayer( );

		// debug
//ma		PrintDebugMessage("Before ResetMultiPlayer");

		ResetMultiplayer( );

		// debug
//ma		PrintDebugMessage("After ResetMultiPlayer");
	}

		// debug
//ma		PrintDebugMessage("Before ResetCamera");

	ResetCamera( );

		// debug
//ma		PrintDebugMessage("Before InitCamera");

	InitCamera();

		// debug
//ma		PrintDebugMessage("Before UpdateEnemies");
	
	UpdateEnemies();

		// debug
//ma		PrintDebugMessage("Before UpdatePlatforms");

	UpdatePlatforms();

		// debug
//ma		PrintDebugMessage("Before UpdateEvents");
	
	UpdateEvents();

		// debug
//ma		PrintDebugMessage("Before StartAmbientSoundsPlay");

	StartAmbientSoundsPlay();

	if(useAudio)
	{
		// debug
//ma		PrintDebugMessage("Before PrepareSong");

		PrepareSong((short)newWorldID,1);
	}

	// debug
//ma	PrintDebugMessage("Before ShowLCDLogo");

	ShowLCDLogo();
}


/*	--------------------------------------------------------------------------------
	Function		: FreeAllLists
	Purpose			: 
	Parameters		: 
	Returns			: 
	Info			: 
*/
void FreeAllLists()
{
	utilPrintf("----------------------------------\n");
	utilPrintf("----- FREEING ALL LISTS ----------\n");
	utilPrintf("----------------------------------\n");

	//memoryShow();
	//memoryShowStats();

//#ifdef PC_VERSION
	StopSong( );
//#endif
	FreeStakFiles();

	FreeMap();
	FreeEntityBank();
	FreeScenic();

	FreeAmbientSoundList();
	FreeSampleList();


	// pump all remaining queued commands..
//ma - err	amErr->number = 0;
	while (qfxPumpCommands() == 0)
	{
		// acknowledge the error
		acSystemDelay(500000);
//ma - err		amErr->number = 0;
	}
	// then flush..
	qfxFlush();


	FreeTriggerList();
	//KillAllTriggers();

	ResetBabies( );

	FreeEnemyLinkedList();
	FreePlatformLinkedList();
	FreePathList();
	FreeTransCameraList();
	FreeLevelScript();
	FreeTongues();
//	FreeWaterObjectList();

	FreeSpecFXList( );
	
	if( gameState.multi != SINGLEPLAYER )
		FreeMultiplayer( );

	FreeParticleList();
	FreeGaribList();
	FreeActorList();
#ifdef PSX_VERSION
	actorInitialise();
#endif

	FreeAllObjectBanks();
	FreeAllTextureBanks();
	
	FreeTextOverlayLinkedList();
	FreeSpriteOverlayLinkedList();
	FreeSpriteList();


#ifdef PC_VERSION
	FreeProcTextures();

	InitSpriteSortArray();
#endif
#ifdef PSX_VERSION
	FreeScenicObjectList();
	FreeTextureAnimList();
#endif

#ifdef PC_VERSION		
	FreeLandscape(&world);
#endif

#ifdef PSX_VERSION
	if(AllowPsiDestroy)
	{
		utilPrintf("psi destroy\n");
		psiDestroy();
		AllowPsiDestroy = 0;
	}
	//FreeBackdrop();
#endif

#ifdef PC_VERSION
	FreeUniqueActorList();
#endif
	
#ifdef PSX_VERSION
//ma	if ( font )
//ma		fontUnload ( font );
	// ENDIF
//ma	font = NULL;

//ma	if ( fontSmall )
//ma		fontUnload ( fontSmall );
	// ENDIF
//ma	fontSmall = NULL;

#endif

//	FREE(playKeyList);

	//memoryShow();
	//memoryShowStats();

#ifdef PSX_VERSION

//ma	lightBeamGouraudValues = NULL;

	memoryReset();
	memoryDestroy();

//	psxCroakVtx=NULL;
	ringVtx = NULL;

	//memoryShow();
	//memoryShowStats();

	MainReset();

	//memoryShow();
	//memoryShowStats();


	//videoInit ( 1024, 3000, 0 );


	//textureInitialise ( 500, 8);
#endif

	if((gameState.single == STORY_MODE) && (!restartingLevel))
	{
		if((player[0].worldNum != WORLDID_FRONTEND) && (storySequence[gameState.storySequenceLevel].fmv != FMV_NONE))
		{
#ifndef NTSC_VERSION
			// *ASL* 12/08/2000 - Force allow quit on video playback
			fmvSoftReset = FMV_SOFTRESET_TOTITLE;
#endif
			StartVideoPlayback(storySequence[gameState.storySequenceLevel].fmv, 1);
		}
	}

//	gameTextInit("LANGUAGE.TXT", LANG_NUM_STRINGS, LANG_NUMLANGS, gameTextLang);

	if (gameState.mode == FRONTEND_MODE)
	{
		InitTextOverlayLinkedList(400);
	}
	else
	{
		InitTextOverlayLinkedList(40);
	}

	InitSpriteOverlayLinkedList();
		
#ifdef PSX_VERSION
//ma	if(loadingLevel)
//ma		loadingInit(player[0].worldNum,player[0].levelNum);
//ma	gameTextInit("LANGUAGE.TXT", LANG_NUM_STRINGS, LANG_NUMLANGS, gameTextLang);
//ma	font = fontLoad("font.pvr");
//ma	fontSmall = fontLoad("smallfont.pvr");
#endif
	
//mm	pOIDistance = ToFixed(500000);
//mm	pointOfInterest = NULL;

	fog.mode = 0;
	pauseMode		= 0;
	darkenedLevel	= 0;
	backGnd = NULL;
	tileNum = NULL;
	dkPressed = 0;
	afterSaveFlag = 0;

#ifdef PC_VERSION
	headMatrix = NULL;
	if( breastMatrix )
		FREE( breastMatrix );
	breastMatrix = NULL;

	if( headPostMatrix )
		FREE( headPostMatrix );
	headPostMatrix = NULL;
#else
	{
		int i;

		//free the 4 head matrix pointers
		pHeadMatrix = NULL;
		for(i=0; i<4; i++)
		{
			pBreastMatrix[i] = NULL;
		}
	}

	backDropObject = NULL;
	
#endif

	utilPrintf("----------------------------------\n");
	utilPrintf("----- DONE FREEING ALL LISTS -----\n");
	utilPrintf("----------------------------------\n");
}

int quitAllVideo;
extern ACTOR oldActor;
void CommonInit(void)
{	
	frameCount=1;
	lastActFrameCount = actFrameCount = 1;

	gameTextInit("LANGUAGE.TXT", LANG_NUM_STRINGS, LANG_NUMLANGS, gameTextLang);

//#ifdef PC_VERSION
//	memcpy(worldVisualData,origWorldVisualData,sizeof(worldVisualData));
//#endif

	memset((void *)&oldActor,0,sizeof(ACTOR));

	frame = 0;
	quitMainLoop = 0;
	InitMatrixStack();

	player[0].worldNum = WORLDID_FRONTEND;
	player[0].levelNum = LEVELID_FRONTEND1;
//	player[0].worldNum = WORLDID_FRONTEND;
//	player[0].levelNum = LEVELID_FRONTEND4;
//	player[0].worldNum = WORLDID_GARDEN;
//	player[0].levelNum = LEVELID_GARDEN1;
//	player[0].worldNum = WORLDID_ANCIENT;
//	player[0].levelNum = LEVELID_ANCIENT3;
//	player[0].worldNum = WORLDID_SUBTERRANEAN;
//	player[0].levelNum = LEVELID_SUBTERRANEAN1;
//	player[0].worldNum = WORLDID_LABORATORY;
//	player[0].levelNum = LEVELID_LABORATORY2;
//	player[0].worldNum = WORLDID_SPACE;
//	player[0].levelNum = LEVELID_SPACE3;
//	player[0].worldNum = WORLDID_HALLOWEEN;
//	player[0].levelNum = LEVELID_HALLOWEEN2;
//	player[0].worldNum = WORLDID_SUPERRETRO;
//	player[0].levelNum = LEVELID_SUPERRETRO2;
	gameState.multi = SINGLEPLAYER;

	GTInit( &modeTimer, 1 );
	frameCount = 0;
			
	// JH: This is done at the start of Initlevel, doses this really need to be done here...........
	//	FreeAllLists();
	frameCount = 0;
	player[0].numSpawn	= 0;

#ifdef E3_DEMO
	StartE3LevelSelect();
#else

	gameState.difficulty = DIFFICULTY_NORMAL;
	gameState.mode = FRONTEND_MODE;
//	gameState.mode = INGAME_MODE;
	InitLevel(player[0].worldNum,player[0].levelNum);
#ifdef PC_VERSION
	LoadGame();
#endif
#endif
}

